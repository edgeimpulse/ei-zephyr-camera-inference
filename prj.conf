## CMakeLists.txt
```
cmake_minimum_required(VERSION 3.20.0)

set(CMAKE_CXX_STANDARD 11)
set(CMAKE_CXX_STANDARD_REQUIRED ON)

# The Edge Impulse model is a Zephyr module exported from Studio. By default we
# pick up the FOMO face detection export sitting next to this application in the
# west workspace; a local model/ directory wins if present, and -DEI_MODEL_DIR=<path>
# overrides both.
if(NOT DEFINED EI_MODEL_DIR)
    if(EXISTS ${CMAKE_CURRENT_SOURCE_DIR}/model/zephyr/module.yml)
        set(EI_MODEL_DIR ${CMAKE_CURRENT_SOURCE_DIR}/model)
    else()
        set(EI_MODEL_DIR
            ${CMAKE_CURRENT_SOURCE_DIR}/../face-detection-fomo-zephyr-module-v217-fomo-96x96)
    endif()
endif()
get_filename_component(EI_MODEL_DIR "${EI_MODEL_DIR}" ABSOLUTE)

if(NOT EXISTS ${EI_MODEL_DIR}/zephyr/module.yml)
    message(FATAL_ERROR
        "No Edge Impulse model module found at ${EI_MODEL_DIR}.\n"
        "Export your impulse as a 'Zephyr module' from Edge Impulse Studio and either\n"
        "drop it in ${CMAKE_CURRENT_SOURCE_DIR}/model or pass -DEI_MODEL_DIR=<path>.")
endif()

message(STATUS "Edge Impulse model module: ${EI_MODEL_DIR}")
list(APPEND ZEPHYR_EXTRA_MODULES ${EI_MODEL_DIR})

find_package(Zephyr REQUIRED HINTS $ENV{ZEPHYR_BASE})

project(ei-zephyr-camera-inference
    DESCRIPTION "Edge Impulse camera inferencing on Zephyr"
    VERSION 1.0.0
    LANGUAGES C CXX ASM
    )

include(utils/cmake/utils.cmake)

# Needed for colorful output
zephyr_compile_options(-fdiagnostics-color=always)

# Project include directories
set(INCLUDES
    .
    src
    )
include_directories(${INCLUDES})

# add all sources to the project
target_sources(app PRIVATE src/main.cpp)
target_sources(app PRIVATE src/camera/ei_camera.cpp)
target_sources(app PRIVATE src/inference/inferencing.cpp)
target_sources(app PRIVATE src/porting/ei_heap.cpp)
```

## Kconfig
```
# Copyright (c) 2026 EdgeImpulse Inc.
# SPDX-License-Identifier: BSD-3-Clause-Clear

mainmenu "Edge Impulse camera inferencing"

menu "Edge Impulse camera configuration"

config EI_CAMERA_WIDTH
	int "Camera capture width in pixels"
	default 160
	help
	  Width the camera is configured to capture at. The frame is centre-cropped
	  to the model aspect ratio and rescaled to EI_CLASSIFIER_INPUT_WIDTH before
	  inference, so this only needs to be a resolution the sensor supports.

config EI_CAMERA_HEIGHT
	int "Camera capture height in pixels"
	default 120
	help
	  Height the camera is configured to capture at. See EI_CAMERA_WIDTH.

config EI_CAMERA_NUM_BUFS
	int "Number of video buffers"
	default 2
	range 1 4
	help
	  Number of buffers in the video buffer pool used for the camera device.
	  CONFIG_VIDEO_BUFFER_POOL_HEAP_SIZE must be large enough to hold them all.

config EI_CAMERA_RGB565_BYTE_SWAP
	bool "Camera delivers RGB565 high byte first"
	help
	  Zephyr documents VIDEO_PIX_FMT_RGB565 ("RGBP") as little endian in memory,
	  but some capture paths hand over the two bytes the other way round while
	  still reporting RGBP. The ESP32-S3 LCD_CAM DVP interface with the OV2640 is
	  one of them (verified by dumping a frame). Enable this to byte swap when
	  unpacking, which is equivalent to treating the frame as RGB565X.

	  The symptom of getting this wrong is an image with the right shapes but
	  wildly cycling rainbow colour bands, because small luminance changes end up
	  flipping the top bits of the red channel.

config EI_CAMERA_STREAM_PER_FRAME
	bool "Start and stop the stream around every frame"
	help
	  video_esp32_dvp stops reloading its DMA the first time its input queue is
	  empty and never restarts it, so with long gaps between captures (an
	  inference takes ~175 ms) streaming dies permanently. Working around that
	  means only streaming while a frame is actually being grabbed.

	  Other drivers do not need this and may not tolerate the cycling -- STM32
	  DCMI in particular keeps DMA state across a frame -- so leave it off and
	  let the stream run continuously.

config EI_CAMERA_HFLIP
	bool "Mirror the captured frame horizontally"
	help
	  Apply VIDEO_CID_HFLIP to the camera. Ignored if the sensor does not
	  support the control.

config EI_CAMERA_VFLIP
	bool "Mirror the captured frame vertically"
	help
	  Apply VIDEO_CID_VFLIP to the camera. Ignored if the sensor does not
	  support the control.

config EI_INFERENCE_INTERVAL_MS
	int "Delay between two inferences in milliseconds"
	default 200
	help
	  Time to sleep after each classification before grabbing the next frame.
	  Set to 0 to run as fast as the camera and the model allow.

config EI_HEAP_SHARED_MULTI_HEAP
	bool "Allocate Edge Impulse memory from the shared multi heap"
	depends on SHARED_MULTI_HEAP
	help
	  Route ei_malloc()/ei_calloc()/ei_free() to the shared multi heap instead
	  of the kernel heap. The EON-compiled model allocates its tensor arena
	  (~240 KB for the 96x96 FOMO model) on first inference; on boards where
	  that does not fit in internal RAM but external RAM is available, such as
	  the octal PSRAM on the ESP32-S3-EYE, this is what makes it fit.
	  When this is disabled the arena comes out of CONFIG_HEAP_MEM_POOL_SIZE,
	  which must then be larger than EI_CLASSIFIER_TFLITE_LARGEST_ARENA_SIZE.

config EI_HEAP_SMH_ATTRIBUTE
	int "Shared multi heap attribute to allocate from"
	depends on EI_HEAP_SHARED_MULTI_HEAP
	default 2
	help
	  Value of enum shared_multi_heap_attr to request: 0 cacheable,
	  1 non-cacheable, 2 external memory.

config EI_INFERENCE_DEBUG
	bool "Enable Edge Impulse debug output"
	help
	  Pass debug=true to run_classifier, which prints the DSP features and
	  per-layer information. Very verbose.

endmenu

source "Kconfig.zephyr"
```

## sample.yaml
```
sample:
  description: Capture frames from a camera and run an Edge Impulse impulse on them
  name: ei-zephyr-camera-inference
common:
    tags: video edge-impulse
    platform_allow:
      - esp32s3_eye/esp32s3/procpu
      - arduino_nicla_vision/stm32h747xx/m7
tests:
  sample.ei.camera.inference:
    build_only: true
```

## west.yml
```
manifest:

  remotes:
    - name: zephyrproject-rtos
      url-base: https://github.com/zephyrproject-rtos

  projects:
    - name: zephyr
      remote:  zephyrproject-rtos
      repo-path: zephyr
      revision: main
      import: true

    - name: edge-impulse-sdk-zephyr
      description: Edge Impulse SDK for Zephyr
      path: modules/edge-impulse-sdk-zephyr
      revision: main
      west-commands: west/west-commands.yml
      url: https://github.com/edgeimpulse/edge-impulse-sdk-zephyr

  self:
    path: ei-zephyr-camera-inference
```

## prj.conf
```kconfig
CONFIG_GPIO=y
# enable c++ support
CONFIG_CPP=y
CONFIG_GLIBCXX_LIBCPP=y
CONFIG_NEWLIB_LIBC=y
CONFIG_REQUIRES_FLOAT_PRINTF=y
CONFIG_FPU=y

#CONFIG_MAIN_STACK_SIZE=16384
CONFIG_MAIN_STACK_SIZE=8192

# Logging
CONFIG_LOG=y
CONFIG_ASSERT=y
CONFIG_LOG_PROCESS_THREAD_STACK_SIZE=1024
# 1024 is not enough for the camera capability listing at boot; it drops messages
CONFIG_LOG_BUFFER_SIZE=4096

# The model allocates its tensor arena from the heap on the first inference.
# It must be larger than EI_CLASSIFIER_TFLITE_LARGEST_ARENA_SIZE in
# model-parameters/model_metadata.h, plus room for the smaller SDK allocations.
# Boards that enable CONFIG_EI_HEAP_SHARED_MULTI_HEAP override this back down.
CONFIG_HEAP_MEM_POOL_SIZE=278528

# Edge Impulse SDK
CONFIG_EDGE_IMPULSE_SDK=y
# 0: malloc/free, 1: k_malloc/k_free
CONFIG_EDGE_IMPULSE_HEAP_TYPE=1

# Camera capture
CONFIG_VIDEO=y
CONFIG_I2C=y
# The video buffer pool must hold CONFIG_EI_CAMERA_NUM_BUFS frames of
# CONFIG_EI_CAMERA_WIDTH x CONFIG_EI_CAMERA_HEIGHT x 2 bytes; override per board.
CONFIG_VIDEO_BUFFER_POOL_HEAP_SIZE=80000
################################################################################
# Debug configuration (logger using RTT)

# CONFIG_LOG2_MODE_DEFERRED=y
# CONFIG_USE_SEGGER_RTT=y
# CONFIG_SEGGER_RTT_BUFFER_SIZE_UP=4096
# CONFIG_LOG_BACKEND_RTT=y
# CONFIG_LOG_PRINTK=y
```

## fixes.conf
```kconfig
# Increase stack sizes for inference
CONFIG_MAIN_STACK_SIZE=16384
CONFIG_SYSTEM_WORKQUEUE_STACK_SIZE=4096
CONFIG_IDLE_STACK_SIZE=2048

# Increase heap for TensorFlow operations
CONFIG_HEAP_MEM_POOL_SIZE=131072

# Enable debug to see where it hangs
CONFIG_LOG=y
CONFIG_LOG_MODE_IMMEDIATE=y
CONFIG_ASSERT=y
CONFIG_ASSERT_VERBOSE=y

# Watchdog timeout increase
CONFIG_TASK_WDT=n

# Stack overflow protection
CONFIG_THREAD_STACK_INFO=y
CONFIG_THREAD_MONITOR=y
```

## boards/arduino_nicla_vision_stm32h747xx_m7.conf
```kconfig
# Arduino Nicla Vision: GC2145 over DCMI.
# The M7 only has 512 KB of AXI SRAM and the tensor arena already takes ~240 KB
# of it, so capture at the smallest resolution the GC2145 supports.
CONFIG_DMA=y

# The video buffers MUST live in the D2 domain. DMA1/DMA2 on the STM32H7 sit in
# D2, and a buffer in the default D1 AXI SRAM (0x24000000) leaves the DCMI DMA
# armed but never completing -- no error, just no frames. SRAM1 is at 0x30000000
# in D2. This also takes the buffers out of the 512 KB the tensor arena competes
# for.
CONFIG_VIDEO_BUFFER_POOL_ZEPHYR_REGION=y
CONFIG_VIDEO_BUFFER_POOL_ZEPHYR_REGION_NAME="SRAM1"
CONFIG_VIDEO_BUFFER_POOL_HEAP_SIZE=160000
CONFIG_EI_CAMERA_NUM_BUFS=1

CONFIG_SERIAL=y
CONFIG_CONSOLE=y
CONFIG_UART_CONSOLE=y
CONFIG_UART_LINE_CTRL=y

# Route LOG_* through printk. The console is USB CDC ACM and the board's CDC
# defconfig sets LOG_PROCESS_THREAD_STARTUP_DELAY_MS=4000 to wait for the host
# to enumerate; with the default deferred mode everything logged during start up
# sits in the ring buffer for four seconds and is lost if anything goes wrong
# before it drains. Minimal mode has no thread and no buffer.
CONFIG_LOG_MODE_MINIMAL=y

# Predicted from the driver source, NOT verified on hardware: gc2145_set_output_format()
# only sets GC2145_REG_BYPASS_MODE_SWITCH (which makes the sensor emit little endian
# RGB565) when bus_type == CSI2_DPHY. This board's dcmi endpoint has no bus-type
# property so it defaults to PARALLEL, the switch bit is never set, and STM32 DCMI
# packs bytes in arrival order (ByteSelectMode = DCMI_BSM_ALL). If the image comes out
# with correct shapes but rainbow colour bands, this got it backwards -- drop the line.
CONFIG_EI_CAMERA_RGB565_BYTE_SWAP=y

# 320x240 is a real discrete mode and gives roughly twice the field of view of
# 160x120: gc2145_set_resolution() clamps its ratio to 3, so the sensor window is
# 960x720 here versus only 480x360 at 160x120.
# The GC2145 is mounted rotated 180 degrees on this board: without both flips
# the frame comes out upside down (verified by dumping the model input).
CONFIG_EI_CAMERA_HFLIP=y
CONFIG_EI_CAMERA_VFLIP=y

CONFIG_EI_CAMERA_WIDTH=320
CONFIG_EI_CAMERA_HEIGHT=240
```

## boards/ek_ra8d1.conf
```kconfig
CONFIG_VIDEO_FRAME_WIDTH=320
CONFIG_VIDEO_FRAME_HEIGHT=240
CONFIG_VIDEO_BUFFER_POOL_HEAP_SIZE=310000
CONFIG_VIDEO_PIXEL_FORMAT="RGBP"
```

## boards/esp32s3_eye_procpu.conf
```kconfig
# ESP32-S3-EYE: OV2640 over the LCD_CAM DVP interface.
CONFIG_ESP_SPIRAM=y
CONFIG_SPIRAM_MODE_OCT=y
CONFIG_DMA_ESP32_MAX_DESCRIPTOR_NUM=64

# The ~240 KB tensor arena does not fit in internal SRAM next to the rest of the
# application, so hand all Edge Impulse allocations to the PSRAM heap.
CONFIG_EI_HEAP_SHARED_MULTI_HEAP=y
CONFIG_EI_HEAP_SMH_ATTRIBUTE=2
CONFIG_HEAP_MEM_POOL_SIZE=16384

# Camera buffers stay in internal SRAM, in their own pool. They must NOT share
# the PSRAM shared-multi-heap with the Edge Impulse allocations above: the GDMA
# writes into these buffers while the CPU allocates and frees EI blocks around
# them, and chunk headers next to a DMA target get smashed. Internal SRAM is
# also uncached on the S3, so there is no DMA/cache hazard either.
CONFIG_VIDEO_BUFFER_POOL_HEAP_SIZE=104448
CONFIG_VIDEO_BUFFER_POOL_ALIGN=32

# The LCD_CAM DVP path reports RGBP but delivers the high byte first; without
# this the frame comes out as rainbow bands. Verified by dumping a raw frame.
CONFIG_EI_CAMERA_RGB565_BYTE_SWAP=y

# The OV2640 is mounted upside down on this board
# video_esp32_dvp dies if its input queue ever empties; only stream while grabbing
CONFIG_EI_CAMERA_STREAM_PER_FRAME=y

CONFIG_EI_CAMERA_VFLIP=y

# The OV2640 driver only accepts the exact sizes in its caps table (no stepping),
# so the choices below QVGA are 160x120, 176x144 and 240x240. 240x240 is the only
# square one, but two of those buffers is 230 KB and leaves internal SRAM at 96%
# full; 176x144 leaves ~37% free. Both are wider than the 96x96 model input.
CONFIG_EI_CAMERA_WIDTH=176
CONFIG_EI_CAMERA_HEIGHT=144
```

## boards/xiao_esp32s3_procpu_sense.conf
```kconfig
# Seeed XIAO ESP32S3 Sense - OV2640 camera on the LCD_CAM DVP interface.
# Build with sysbuild so MCUboot is built alongside the app:
#   west build --sysbuild -p -b xiao_esp32s3/esp32s3/procpu/sense .

CONFIG_BOOTLOADER_MCUBOOT=y

CONFIG_ESP_SPIRAM=y
CONFIG_VIDEO_BUFFER_USE_SHARED_MULTI_HEAP=y
CONFIG_VIDEO_BUFFER_SMH_ATTRIBUTE=2
CONFIG_VIDEO_BUFFER_POOL_ALIGN=32
CONFIG_VIDEO_BUFFER_POOL_HEAP_SIZE=230400

CONFIG_DMA_ESP32_MAX_DESCRIPTOR_NUM=64
```

## boards/arduino_nicla_vision_stm32h747xx_m7.overlay
```dts
/*
 * Copyright (c) 2026 EdgeImpulse Inc.
 * SPDX-License-Identifier: Apache-2.0
 */

#include <zephyr/dt-bindings/dma/stm32_dma.h>

/*
 * Re-describe the DCMI DMA channel with a 32-bit peripheral data width.
 *
 * The SoC devicetree declares STM32_DMA_PERIPH_8BITS, but DCMI_DR is a 32-bit
 * register and ST's reference configuration uses a word-aligned peripheral
 * side. That mismatch used to be harmless because the driver filled in the HAL
 * DMA_InitTypeDef itself; since the DMA HAL config helper was introduced the
 * HAL fields are derived from this cell instead, and every DCMI transfer fails
 * with HAL_DCMI_ERROR_DMA (0x40) -- the driver then restarts the DMA forever
 * and no frame is ever delivered.
 */
&dcmi {
	dmas = <&dma1 1 75 (STM32_DMA_PERIPH_TO_MEMORY | STM32_DMA_PERIPH_NO_INC |
			    STM32_DMA_MEM_INC | STM32_DMA_PERIPH_32BITS |
			    STM32_DMA_MEM_32BITS |
			    STM32_DMA_PRIORITY_HIGH) STM32_DMA_FIFO_FULL>;
};

/*
 * Merge SRAM1 and SRAM2 into a single 256 KB region.
 *
 * They are contiguous (0x30000000 + 128K = SRAM2's base) and nothing else on
 * this board uses either of them. SRAM0 is zephyr,sram -- the main system RAM,
 * already ~64% full because the tensor arena lives there -- so keeping the
 * frame buffer out of it leaves real headroom. One 320x240 RGB565 frame is
 * 153600 B, which does not fit in SRAM1's 128 KB alone.
 */
&sram2 {
	status = "disabled";
};

&sram1 {
	reg = <0x30000000 0x40000>;
};
```

## src/main.cpp
```c
/* The Clear BSD License
 *
 * Copyright (c) 2026 EdgeImpulse Inc.
 * All rights reserved.
 *
 * Redistribution and use in source and binary forms, with or without
 * modification, are permitted (subject to the limitations in the disclaimer
 * below) provided that the following conditions are met:
 *
 *   * Redistributions of source code must retain the above copyright notice,
 *   this list of conditions and the following disclaimer.
 *
 *   * Redistributions in binary form must reproduce the above copyright
 *   notice, this list of conditions and the following disclaimer in the
 *   documentation and/or other materials provided with the distribution.
 *
 *   * Neither the name of the copyright holder nor the names of its
 *   contributors may be used to endorse or promote products derived from this
 *   software without specific prior written permission.
 *
 * NO EXPRESS OR IMPLIED LICENSES TO ANY PARTY'S PATENT RIGHTS ARE GRANTED BY
 * THIS LICENSE. THIS SOFTWARE IS PROVIDED BY THE COPYRIGHT HOLDERS AND
 * CONTRIBUTORS "AS IS" AND ANY EXPRESS OR IMPLIED WARRANTIES, INCLUDING, BUT NOT
 * LIMITED TO, THE IMPLIED WARRANTIES OF MERCHANTABILITY AND FITNESS FOR A
 * PARTICULAR PURPOSE ARE DISCLAIMED. IN NO EVENT SHALL THE COPYRIGHT HOLDER OR
 * CONTRIBUTORS BE LIABLE FOR ANY DIRECT, INDIRECT, INCIDENTAL, SPECIAL,
 * EXEMPLARY, OR CONSEQUENTIAL DAMAGES (INCLUDING, BUT NOT LIMITED TO,
 * PROCUREMENT OF SUBSTITUTE GOODS OR SERVICES; LOSS OF USE, DATA, OR PROFITS; OR
 * BUSINESS INTERRUPTION) HOWEVER CAUSED AND ON ANY THEORY OF LIABILITY, WHETHER
 * IN CONTRACT, STRICT LIABILITY, OR TORT (INCLUDING NEGLIGENCE OR OTHERWISE)
 * ARISING IN ANY WAY OUT OF THE USE OF THIS SOFTWARE, EVEN IF ADVISED OF THE
 * POSSIBILITY OF SUCH DAMAGE.
 */

#include <zephyr/kernel.h>
#include <stdio.h>

#include "camera/ei_camera.h"
#include "inference/inferencing.h"

int main(void)
{
    // This is needed so that output of printf is output immediately without buffering
    setvbuf(stdout, NULL, _IONBF, 0);

    if (ei_camera_init() == false) {
        /* Returning from main() here would leave the board running but
         * completely silent, which is indistinguishable from a hang. Keep
         * repeating the reason so it is visible whenever a terminal attaches.
         */
        while (true) {
            printk("ERR: Failed to initialize the camera\n");
            k_sleep(K_SECONDS(2));
        }
    }

    ei_inference_sm(); // run state machine

    while (true) {
        printk("ERR: Inferencing stopped\n");
        k_sleep(K_SECONDS(2));
    }

    return 0;
}
```

## src/memory_mgmt.cpp
```c
/* The Clear BSD License
*
* Copyright (c) 2025 EdgeImpulse Inc.
* All rights reserved.
*
* Redistribution and use in source and binary forms, with or without
* modification, are permitted (subject to the limitations in the disclaimer
* below) provided that the following conditions are met:
*
*   * Redistributions of source code must retain the above copyright notice,
*   this list of conditions and the following disclaimer.
*
*   * Redistributions in binary form must reproduce the above copyright
*   notice, this list of conditions and the following disclaimer in the
*   documentation and/or other materials provided with the distribution.
*
*   * Neither the name of the copyright holder nor the names of its
*   contributors may be used to endorse or promote products derived from this
*   software without specific prior written permission.
*
* NO EXPRESS OR IMPLIED LICENSES TO ANY PARTY'S PATENT RIGHTS ARE GRANTED BY
* THIS LICENSE. THIS SOFTWARE IS PROVIDED BY THE COPYRIGHT HOLDERS AND
* CONTRIBUTORS "AS IS" AND ANY EXPRESS OR IMPLIED WARRANTIES, INCLUDING, BUT NOT
* LIMITED TO, THE IMPLIED WARRANTIES OF MERCHANTABILITY AND FITNESS FOR A
* PARTICULAR PURPOSE ARE DISCLAIMED. IN NO EVENT SHALL THE COPYRIGHT HOLDER OR
* CONTRIBUTORS BE LIABLE FOR ANY DIRECT, INDIRECT, INCIDENTAL, SPECIAL,
* EXEMPLARY, OR CONSEQUENTIAL DAMAGES (INCLUDING, BUT NOT LIMITED TO,
* PROCUREMENT OF SUBSTITUTE GOODS OR SERVICES; LOSS OF USE, DATA, OR PROFITS; OR
* BUSINESS INTERRUPTION) HOWEVER CAUSED AND ON ANY THEORY OF LIABILITY, WHETHER
* IN CONTRACT, STRICT LIABILITY, OR TORT (INCLUDING NEGLIGENCE OR OTHERWISE)
* ARISING IN ANY WAY OUT OF THE USE OF THIS SOFTWARE, EVEN IF ADVISED OF THE
* POSSIBILITY OF SUCH DAMAGE.
*/

#include <zephyr/kernel.h>
#include "memory_mgmt.h"
#include "edge-impulse-sdk/porting/ei_classifier_porting.h"

#if defined(CONFIG_USE_SHARED_MULTI_HEAP) && (CONFIG_USE_SHARED_MULTI_HEAP != 0)
#include <zephyr/multi_heap/shared_multi_heap.h>

#define DEBUG_MEM_MGMT 0

void *ei_malloc(size_t size)
{
#if DEBUG_MEM_MGMT == 1
    ei_printf("ei_malloc: allocating %d bytes\r\n", (int)size);
    void *ptr = shared_multi_heap_aligned_alloc(SMH_REG_ATTR_EXTERNAL, 32, size);
    ei_printf("ei_malloc: allocated %d bytes at address %p\r\n", (int)size, ptr);
    return ptr;
#else
    return shared_multi_heap_aligned_alloc(SMH_REG_ATTR_EXTERNAL, 32, size);
#endif
}

void *ei_calloc(size_t nitems, size_t size)
{
#if DEBUG_MEM_MGMT == 1
    ei_printf("ei_calloc: allocating %d bytes\r\n", (int)(size * nitems));
    void *ptr = shared_multi_heap_aligned_alloc(SMH_REG_ATTR_EXTERNAL, 32, size * nitems);
    ei_printf("ei_calloc: allocated %d bytes at address %p\r\n", (int)(size * nitems), ptr);
    return ptr;
#else
    return shared_multi_heap_aligned_alloc(SMH_REG_ATTR_EXTERNAL, 32, size * nitems);
#endif
}

void ei_free(void *ptr)
{
#if DEBUG_MEM_MGMT == 1
    ei_printf("ei_free: freeing memory at address %p\r\n", ptr);
#endif
    shared_multi_heap_free(ptr);
#if DEBUG_MEM_MGMT == 1
    ei_printf("after ei_free: freed %p\r\n", ptr);
#endif
}

#elif defined(CONFIG_USE_EXTERNAL_HEAP) && (CONFIG_USE_EXTERNAL_HEAP != 0)

static char Z_GENERIC_SECTION(CONFIG_USE_EXTERNAL_HEAP_SECTION) additional_heap_buffer[CONFIG_HEAP_MEM_POOL_SIZE];
static struct k_heap additional_heap_pool;
static bool mem_heap_initialized = false;

void init_external_heap(void)
{
    if (mem_heap_initialized == false) {
        mem_heap_initialized = true;
        k_heap_init(&additional_heap_pool, additional_heap_buffer, sizeof(additional_heap_buffer));
    }
}

void *ei_malloc(size_t size) {
    return k_heap_alloc(&additional_heap_pool, size, K_NO_WAIT);
}

void *ei_calloc(size_t nitems, size_t size) {
    return k_heap_calloc(&additional_heap_pool, nitems, size, K_NO_WAIT);
}

void ei_free(void *ptr) {
    k_heap_free(&additional_heap_pool, ptr);
}

#else
// the standard ei_malloc/ei_free will be used

#endif
```

## src/memory_mgmt.h
```c
/* The Clear BSD License
 *
 * Copyright (c) 2025 EdgeImpulse Inc.
 * All rights reserved.
 *
 * Redistribution and use in source and binary forms, with or without
 * modification, are permitted (subject to the limitations in the disclaimer
 * below) provided that the following conditions are met:
 *
 *   * Redistributions of source code must retain the above copyright notice,
 *   this list of conditions and the following disclaimer.
 *
 *   * Redistributions in binary form must reproduce the above copyright
 *   notice, this list of conditions and the following disclaimer in the
 *   documentation and/or other materials provided with the distribution.
 *
 *   * Neither the name of the copyright holder nor the names of its
 *   contributors may be used to endorse or promote products derived from this
 *   software without specific prior written permission.
 *
 * NO EXPRESS OR IMPLIED LICENSES TO ANY PARTY'S PATENT RIGHTS ARE GRANTED BY
 * THIS LICENSE. THIS SOFTWARE IS PROVIDED BY THE COPYRIGHT HOLDERS AND
 * CONTRIBUTORS "AS IS" AND ANY EXPRESS OR IMPLIED WARRANTIES, INCLUDING, BUT NOT
 * LIMITED TO, THE IMPLIED WARRANTIES OF MERCHANTABILITY AND FITNESS FOR A
 * PARTICULAR PURPOSE ARE DISCLAIMED. IN NO EVENT SHALL THE COPYRIGHT HOLDER OR
 * CONTRIBUTORS BE LIABLE FOR ANY DIRECT, INDIRECT, INCIDENTAL, SPECIAL,
 * EXEMPLARY, OR CONSEQUENTIAL DAMAGES (INCLUDING, BUT NOT LIMITED TO,
 * PROCUREMENT OF SUBSTITUTE GOODS OR SERVICES; LOSS OF USE, DATA, OR PROFITS; OR
 * BUSINESS INTERRUPTION) HOWEVER CAUSED AND ON ANY THEORY OF LIABILITY, WHETHER
 * IN CONTRACT, STRICT LIABILITY, OR TORT (INCLUDING NEGLIGENCE OR OTHERWISE)
 * ARISING IN ANY WAY OUT OF THE USE OF THIS SOFTWARE, EVEN IF ADVISED OF THE
 * POSSIBILITY OF SUCH DAMAGE.
 */

#ifndef MEM_MGMT_H
#define MEM_MGMT_H

#if defined(CONFIG_USE_EXTERNAL_HEAP) && (CONFIG_USE_EXTERNAL_HEAP != 0)

extern void init_external_heap(void);

#endif

#endif // MEM_MGMT_H
```
